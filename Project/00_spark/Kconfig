## Project/00_spark/Kconfig
```kconfig
mainmenu "RT-Thread Configuration"

BSP_DIR := .

RTT_DIR := rt-thread

PKGS_DIR := packages

config SOC_STM32F407ZG
    bool
    select SOC_SERIES_STM32F4
    select RT_USING_COMPONENTS_INIT
    select RT_USING_USER_MAIN
    default y

config BOARD_STM32F407_SPARK
    bool
    default y

source "$(RTT_DIR)/Kconfig"
osource "$PKGS_DIR/Kconfig"
rsource "libraries/Kconfig"

if !RT_USING_NANO
rsource "board/Kconfig"
endif

menu "hello module"

    config RT_USING_HELLO
        bool "Enable hello module"
        default y
        help
        this hello module only used for test

    config RT_HELLO_NAME
        string "hello name"
        default "hello"

    config RT_HELLO_VALUE
        int "hello value"
        default 8
endmenu
```
